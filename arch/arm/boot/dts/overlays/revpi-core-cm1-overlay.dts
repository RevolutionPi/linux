// SPDX-License-Identifier: GPL-2.0-only
// SPDX-FileCopyrightText: Copyright 2022-2025 KUNBUS GmbH

/*
 * Device tree overlay for Revolution Pi by KUNBUS
 *
 * RevPi Core
 */

#include "revpi-core-overlay.dts"

/{
	/delete-node/ fragment@9;
	fragment@9 {
		target = <&usb>;
		__overlay__ {
			#address-cells = <1>;
			#size-cells = <0>;

			/* Use dwc_otg (instead of dwc2) on CM1 for better performance. */
			#include "revpi-core-usb.dtsi"
		};
	};
};
