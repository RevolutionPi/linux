// SPDX-License-Identifier: GPL-2.0-only
// SPDX-FileCopyrightText: 2024 KUNBUS GmbH

/*
 * Device tree overlay for Revolution Pi by KUNBUS
 *
 * Enable DSA support on RevPi Flat S (2022)
 */

 #include "revpi-flat-s-2022-overlay.dts"

/{
	compatible = "brcm,bcm2711";

	fragment@3 {
		target = <&spi5>;
		__overlay__ {
			ksz8795: switch@1 {
				status = "okay";
			};
		};
	};
};
