// SPDX-License-Identifier: GPL-2.0-only
// SPDX-FileCopyrightText: Copyright 2022-2025 KUNBUS GmbH
/*
 * Device tree overlay for Revolution Pi by KUNBUS
 *
 * RevPi Core S (2022)
 */

 #include "revpi-core-2022-overlay.dts"

/{
	compatible = "brcm,bcm2711";

	fragment@0 {
		target-path = "/";
		__overlay__ {
			compatible = "kunbus,revpi-core-s-2022",
				     "kunbus,revpi-core", "brcm,bcm2711";
		};
	};

	/delete-node/ fragment@9;
	fragment@9 {
		target = <&xhci>;
		xhci_usb: __overlay__ {
			status = "okay";
			#include "revpi-core-usb.dtsi"
		};
	};
};
