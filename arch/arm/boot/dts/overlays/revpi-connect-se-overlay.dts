/*
 * Device tree overlay for Revolution Pi by KUNBUS
 *
 * RevPi Connect SE
 */

#include "revpi-connect-overlay.dts"

/{
	compatible = "brcm,bcm2837";

	fragment@0 {
		target-path = "/";
		__overlay__ {
			compatible = "kunbus,revpi-connect-se", "brcm,bcm2711";
			/delete-node/ regulator_pbrst;
		};
	};

	fragment@6 {
		target = <&spi0_cs_pins>;
		__overlay__ {
			brcm,pins     = <36 35>;
			brcm,function = <BCM2835_FSEL_GPIO_OUT>;
			brcm,pull     = <BCM2835_PUD_OFF>;
		};
	};

	fragment@7 {
		target = <&spi0>;
		__overlay__ {
			cs-gpios = <&gpio 36 GPIO_ACTIVE_LOW>;
			/delete-node/ ethernet@1;
		};
	};

	__overrides__ {
		/delete-property/ pileft_mac_hi;
		/delete-property/ pileft_mac_lo;
	};
};
