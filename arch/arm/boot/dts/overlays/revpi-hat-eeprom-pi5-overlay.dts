// SPDX-License-Identifier: GPL-2.0-only
// SPDX-FileCopyrightText: Copyright 2024 KUNBUS GmbH

/dts-v1/;
/plugin/;

/{
	compatible = "brcm,bcm2712";

	fragment@0 {
		target = <&i2c0>;
		__overlay__ {
			pinctrl-names = "default";
			pinctrl-0 = <&i2c0_pins>;
			#address-cells = <1>;
			#size-cells = <0>;
			clock-frequency = <400000>;
			status = "okay";

			eeprom: eeprom@50 {
				compatible = "atmel,24c256";
				reg = <0x50>;
				pagesize = <64>;
				status = "okay";
			};
		};
	};
};
